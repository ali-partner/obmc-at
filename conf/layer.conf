## conf/machine/obmc-nmx36-upstream-overrides.conf
```bitbake
YV5A7_ASSUMED_PROVIDERS = ""
YV5A7_IMAGE_FSTYPES_REMOVE = ""

PREFERRED_PROVIDER_virtual/kernel = "linux-aspeed"

PREFERRED_VERSION_u-boot-aspeed-sdk = "v2023.10%"
PREFERRED_VERSION_u-boot-fw-utils-aspeed-sdk = "v2023.10%"
PREFERRED_VERSION_u-boot-fw-utils-aspeed-sdk-cross = "v2023.10%"

KERNEL_DEVICETREE = "aspeed/ast2700-evb.dtb"
UBOOT_DEVICETREE = "ast2700-evb"

PREFERRED_PROVIDER_virtual/bootmcu = "zephyr-aspeed-bootmcu"

ZEPHYR_TOOLCHAIN_VARIANT = "zephyr"
PREFERRED_VERSION_zephyr-sdk-native = "0.16.9"
PREFERRED_VERSION_zephyr-kernel ??= "3.7.0"

PREFERRED_VERSION_libwatchdog = "0.2"
PREFERRED_VERSION_libbic = "0.1"
PREFERRED_VERSION_bic-util = "0.1"

PREFERRED_VERSION_bios-util = "0.2"
PREFERRED_VERSION_asd = "1.4.3"
PREFERRED_VERSION_libasd-jtagintf = "0.1"
PREFERRED_VERSION_libpal = "0.2"

SERIAL_CONSOLES:facebook = "9600;ttyS4"

IMAGE_FEATURES:remove = "read-only-rootfs"
```
